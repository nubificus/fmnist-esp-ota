## sdkconfig.defaults
```kconfig
#CONFIG_SECURE_BOOT=y
#CONFIG_SECURE_BOOTLOADER_REFLASHABLE=y

CONFIG_ESPTOOLPY_FLASHSIZE_8MB=y
CONFIG_ESPTOOLPY_HEADER_FLASHSIZE_UPDATE=y

CONFIG_PARTITION_TABLE_CUSTOM=y
CONFIG_PARTITION_TABLE_CUSTOM_FILENAME="partitions.csv"
CONFIG_PARTITION_TABLE_OFFSET=0x10000

# Use OTA-only partition scheme (no factory app)
CONFIG_ESP_IMAGE_BOOTLOADER_SEL_OTA=y

CONFIG_ESP_WIFI_GMAC_SUPPORT=n

CONFIG_PARTITION_TABLE_MD5=y
CONFIG_MBEDTLS_HKDF_C=y

CONFIG_SPIRAM=y
CONFIG_SPIRAM_MODE_QUAD=y
#CONFIG_SPIRAM_MODE_OCT=y
CONFIG_SPIRAM_TYPE_AUTO=y
CONFIG_SPIRAM_SPEED_40M=y
CONFIG_SPIRAM_SPEED=40
CONFIG_SPIRAM_BOOT_INIT=y
CONFIG_SPIRAM_USE_MALLOC=y
CONFIG_SPIRAM_MEMTEST=y
CONFIG_SPIRAM_MALLOC_ALWAYSINTERNAL=16384
CONFIG_SPIRAM_MALLOC_RESERVE_INTERNAL=32768
```

## sdkconfig.defaults.internal
```kconfig
CONFIG_SECURE_BOOT=y
CONFIG_SECURE_BOOTLOADER_REFLASHABLE=y

CONFIG_ESPTOOLPY_FLASHSIZE_8MB=y
CONFIG_ESPTOOLPY_HEADER_FLASHSIZE_UPDATE=y

CONFIG_PARTITION_TABLE_CUSTOM=y
CONFIG_PARTITION_TABLE_CUSTOM_FILENAME="partitions.csv"
CONFIG_PARTITION_TABLE_OFFSET=0x10000

# Use OTA-only partition scheme (no factory app)
CONFIG_ESP_IMAGE_BOOTLOADER_SEL_OTA=y

CONFIG_ESP_WIFI_GMAC_SUPPORT=n

CONFIG_PARTITION_TABLE_MD5=y
CONFIG_MBEDTLS_HKDF_C=y
```
